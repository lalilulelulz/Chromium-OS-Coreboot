## src/cpu/intel/model_106cx/Kconfig
```kconfig
config CPU_INTEL_MODEL_106CX
	bool
	select SMP
	select SSE2
	select UDELAY_LAPIC
	select AP_IN_SIPI_WAIT

if CPU_INTEL_MODEL_106CX

config BOOTBLOCK_CPU_INIT
	string
	default "cpu/intel/model_106cx/bootblock.c"

config CACHE_MRC_BIN
	bool
	default n

config SERIAL_CPU_INIT
	bool
	default n

endif
```

## src/cpu/intel/model_306ax/Kconfig
```kconfig
config CPU_INTEL_MODEL_206AX
	bool
	select SMP
	select SSE2
	select UDELAY_LAPIC
	select AP_IN_SIPI_WAIT

if CPU_INTEL_MODEL_206AX

config BOOTBLOCK_CPU_INIT
	string
	default "cpu/intel/model_206ax/bootblock.c"

config SERIAL_CPU_INIT
	bool
	default n

endif
```

## src/cpu/intel/socket_rPGA989/Kconfig
```kconfig
config CPU_INTEL_SOCKET_RPGA989
	bool

if CPU_INTEL_SOCKET_RPGA989

config SOCKET_SPECIFIC_OPTIONS # dummy
	def_bool y
	select CPU_INTEL_MODEL_206AX
	select MMX
	select SSE
	select CACHE_AS_RAM

config CACHE_MRC_BIN
	bool
	default n

config CACHE_MRC_SIZE_KB
	int "MRC Cache Size in KB"
	default 256

config DCACHE_MRC_BASE
	hex
	default 0xfffd0000

config DCACHE_RAM_BASE
	hex
	default 0xff7f0000

config DCACHE_RAM_SIZE
	hex
	default 0x10000

config DCACHE_RAM_MRC_VAR_SIZE
	hex
	default 0x4000

endif
```

## src/drivers/intel/wifi/Kconfig
```kconfig
config DRIVERS_INTEL_WIFI
	bool "Support Intel PCI-e WiFi adapters"
	depends on ARCH_X86
	default y if PCIEXP_PLUGIN_SUPPORT
	help
	   When enabled, add identifiers in ACPI and SMBIOS tables to
	   make OS drivers work with certain Intel PCI-e WiFi chipsets.

config ENABLE_WIFI_SSDT
  bool "Support for generating SSDT table"
  depends on DRIVERS_INTEL_WIFI
  default n
  help
     When enabled, populate Intel WiFi device info into SSDT instead of
     declaring in the DSDT of each main board.

config USE_SAR
	bool
	default n
	help
	  Enable it when wifi driver uses SAR configuration feature.
	  VPD entry "wifi_sar" is required to support it.

config SAR_ENABLE
	bool
	default n
	depends on USE_SAR

config DSAR_ENABLE
	bool
	default n
	depends on USE_SAR

config DSAR_SET_NUM
	hex "Number of SAR sets when D-SAR is enabled"
	default 0x3
	depends on USE_SAR
	help
	  There can be up to 3 optional SAR table sets.
```

## src/mainboard/acer/Kconfig
```kconfig
if VENDOR_ACER

choice
	prompt "Mainboard model"

config BOARD_ACER_KIEV
	bool "Kiev"

endchoice

source "src/mainboard/acer/kiev/Kconfig"

config MAINBOARD_VENDOR
	string
	default "ACER"

endif # VENDOR_ACER
```

## src/mainboard/evoc/Kconfig
```kconfig
if VENDOR_EVOC

choice
	prompt "Mainboard model"

config BOARD_EVOC_MEC_7003
	bool "MEC-7003"

endchoice

source "src/mainboard/evoc/mec-7003/Kconfig"

config MAINBOARD_VENDOR
	string
	default "Evoc"

endif # VENDOR_EVOC
```

## src/mainboard/evoc/mec-7003/Kconfig
```kconfig
if BOARD_EVOC_MEC_7003

config BOARD_SPECIFIC_OPTIONS # dummy
	def_bool y
	select ARCH_X86
	select CPU_INTEL_SOCKET_RPGA989
	select NORTHBRIDGE_INTEL_SANDYBRIDGE
	select SOUTHBRIDGE_INTEL_BD82X6X
	select SUPERIO_NUVOTON_NCT6776F
	select SUPERIO_SMSC_FDC37N972
	select BOARD_HAS_FADT
	select HAVE_ACPI_TABLES
	select HAVE_OPTION_TABLE
	select HAVE_ACPI_RESUME
	select MMCONF_SUPPORT
	select HAVE_SMI_HANDLER
	select BOARD_ROMSIZE_KB_2048
	select GFXUMA

config MAINBOARD_DIR
	string
	default evoc/mec-7003

config MAINBOARD_PART_NUMBER
	string
	default "MEC-7003"

config MMCONF_BASE_ADDRESS
	hex
	default 0xf0000000

config IRQ_SLOT_COUNT
	int
	default 18

config MAX_CPUS
	int
	default 8

config MAX_PHYSICAL_CPUS
	int
	default 2

config VGA_BIOS_FILE
	string
	default "pci8086,a011.rom"

config MAINBOARD_PCI_SUBSYSTEM_VENDOR_ID
	hex
	default 0x1ae0

config MAINBOARD_PCI_SUBSYSTEM_DEVICE_ID
	hex
	default 0xc000

endif # BOARD_EVOC_MEC_7003
```

## src/mainboard/google/Kconfig
```kconfig
##
## This file is part of the coreboot project.
##
## Copyright (C) 2012 The ChromiumOS Authors
##
## This program is free software; you can redistribute it and/or modify
## it under the terms of the GNU General Public License as published by
## the Free Software Foundation; version 2 of the License.
##
## This program is distributed in the hope that it will be useful,
## but WITHOUT ANY WARRANTY; without even the implied warranty of
## MERCHANTABILITY or FITNESS FOR A PARTICULAR PURPOSE.  See the
## GNU General Public License for more details.
##
## You should have received a copy of the GNU General Public License
## along with this program; if not, write to the Free Software
## Foundation, Inc., 51 Franklin St, Fifth Floor, Boston, MA 02110-1301 USA
##
if VENDOR_GOOGLE

# Auto select common options
config VENDOR_SPECIFIC_OPTIONS
	def_bool y
	select CACHE_ROM

choice
	prompt "Mainboard model"

config BOARD_GOOGLE_BANJO
	bool "Banjo"
config BOARD_GOOGLE_BELTINO
	bool "Beltino"
config BOARD_GOOGLE_BOLT
	bool "Bolt"
config BOARD_GOOGLE_BUTTERFLY
	bool "Butterfly"
config BOARD_GOOGLE_CANDY
	bool "Candy"
config BOARD_GOOGLE_CLAPPER
	bool "Clapper"
config BOARD_GOOGLE_CRANKY
	bool "Cranky"
config BOARD_GOOGLE_ENGUARDE
	bool "Enguarde"
config BOARD_GOOGLE_EXPRESSO
	bool "Expresso"
config BOARD_GOOGLE_FALCO
	bool "Falco"
config BOARD_GOOGLE_GLIMMER
	bool "Glimmer"
config BOARD_GOOGLE_GLOWER
	bool "Glower"
config BOARD_GOOGLE_GNAWTY
        bool "Gnawty"
config BOARD_GOOGLE_KIP
	bool "Kip"
config BOARD_GOOGLE_LINK
	bool "Link"
config BOARD_GOOGLE_NINJA
	bool "Ninja"
config BOARD_GOOGLE_NYAN
	bool "Nyan"
config BOARD_GOOGLE_ORCO
        bool "Orco"
config BOARD_GOOGLE_PANTHER
	bool "Panther"
config BOARD_GOOGLE_PARROT
	bool "Parrot"
config BOARD_GOOGLE_PARRY
	bool "Parry"
config BOARD_GOOGLE_PEPPY
	bool "Peppy"
config BOARD_GOOGLE_PIT
	bool "Pit"
config BOARD_GOOGLE_QUAWKS
	bool "Quawks"
config BOARD_GOOGLE_RAMBI
	bool "Rambi"
config BOARD_GOOGLE_SAMUS
	bool "Samus"
config BOARD_GOOGLE_SLIPPY
	bool "Slippy"
config BOARD_GOOGLE_SNOW
	bool "Snow"
config BOARD_GOOGLE_SQUAWKS
	bool "Squawks"
config BOARD_GOOGLE_STOUT
	bool "Stout"
config BOARD_GOOGLE_SUMO
        bool "Sumo"
config BOARD_GOOGLE_SWANKY
	bool "Swanky"
config BOARD_GOOGLE_WINKY
	bool "Winky"

endchoice

source "src/mainboard/google/banjo/Kconfig"
source "src/mainboard/google/beltino/Kconfig"
source "src/mainboard/google/bolt/Kconfig"
source "src/mainboard/google/butterfly/Kconfig"
source "src/mainboard/google/clapper/Kconfig"
source "src/mainboard/google/candy/Kconfig"
source "src/mainboard/google/cranky/Kconfig"
source "src/mainboard/google/enguarde/Kconfig"
source "src/mainboard/google/expresso/Kconfig"
source "src/mainboard/google/falco/Kconfig"
source "src/mainboard/google/glimmer/Kconfig"
source "src/mainboard/google/glower/Kconfig"
source "src/mainboard/google/gnawty/Kconfig"
source "src/mainboard/google/kip/Kconfig"
source "src/mainboard/google/link/Kconfig"
source "src/mainboard/google/ninja/Kconfig"
source "src/mainboard/google/nyan/Kconfig"
source "src/mainboard/google/orco/Kconfig"
source "src/mainboard/google/panther/Kconfig"
source "src/mainboard/google/parrot/Kconfig"
source "src/mainboard/google/parry/Kconfig"
source "src/mainboard/google/peppy/Kconfig"
source "src/mainboard/google/pit/Kconfig"
source "src/mainboard/google/quawks/Kconfig"
source "src/mainboard/google/rambi/Kconfig"
source "src/mainboard/google/samus/Kconfig"
source "src/mainboard/google/slippy/Kconfig"
source "src/mainboard/google/snow/Kconfig"
source "src/mainboard/google/squawks/Kconfig"
source "src/mainboard/google/stout/Kconfig"
source "src/mainboard/google/sumo/Kconfig"
source "src/mainboard/google/swanky/Kconfig"
source "src/mainboard/google/winky/Kconfig"

config MAINBOARD_VENDOR
	string "Mainboard Vendor"
	default "GOOGLE"

endif # VENDOR_GOOGLE
```

## src/soc/qualcomm/ipq40xx/Kconfig
```kconfig
config SOC_QC_IPQ40XX
	bool
	default n
	select ARCH_BOOTBLOCK_ARMV7
	select ARCH_VERSTAGE_ARMV7
	select ARCH_VERSTAGE_ARMV7_ENABLE_NEON
	select ARCH_ROMSTAGE_ARMV7
	select ARCH_RAMSTAGE_ARMV7
	select BOOTBLOCK_CONSOLE
	select CFLAGS_NO_OMIT_FRAME_POINTER
	select CHROMEOS_VBNV_FLASH
	select HAS_PRECBMEM_TIMESTAMP_REGION
	select HAVE_UART_SPECIAL
	select SPI_ATOMIC_SEQUENCING
	select GENERIC_GPIO_LIB
	select SEPARATE_VERSTAGE
	select RETURN_FROM_VERSTAGE
	select HAVE_MONOTONIC_TIMER

if SOC_QC_IPQ40XX

config IPQ_QFN_PART
	bool "Is the SoC a BGA part or QFN part"
	default n

config MBN_ENCAPSULATION
	depends on USE_BLOBS
	bool "bootblock encapsulation for ipq40xx"
	default y

config CDT_MBN
	string "CDT binary blob"
	default "cdt-AP.DK01.1-C1.bin"

config DDR_MBN
	string "DDR driver binary blob"
	default "ddr.mbn"

config TZ_MBN
	string "TZ binary blob"
	default "tzbsp_no_xpu.mbn"

config SBL_ELF
	depends on USE_BLOBS
	string "file name of the QCA SBL ELF"
	default "3rdparty/blobs/cpu/qualcomm/ipq40xx/sbl.elf"
	help
	  The path and filename of the binary blob containing
	  ipq40xx early initialization code, as supplied by the
	  vendor.

config SBL_UTIL_PATH
	depends on USE_BLOBS
	string "Path for utils to combine SBL_ELF and bootblock"
	default "util/ipqheader"
	help
	  Path for utils to combine SBL_ELF and bootblock

config HEAP_SIZE
	hex
	default 0x8000

endif
```

## src/southbridge/intel/bd82x6x/Kconfig
```kconfig
##
## This file is part of the coreboot project.
##
## Copyright (C) 2011 Google Inc.
##
## This program is free software; you can redistribute it and/or modify
## it under the terms of the GNU General Public License as published by
## the Free Software Foundation; version 2 of the License.
##
## This program is distributed in the hope that it will be useful,
## but WITHOUT ANY WARRANTY; without even the implied warranty of
## MERCHANTABILITY or FITNESS FOR A PARTICULAR PURPOSE.  See the
## GNU General Public License for more details.
##
## You should have received a copy of the GNU General Public License
## along with this program; if not, write to the Free Software
## Foundation, Inc., 51 Franklin St, Fifth Floor, Boston, MA  02110-1301 USA
##

config SOUTHBRIDGE_INTEL_BD82X6X
	bool
	select IOAPIC
	select HAVE_HARD_RESET
	select HAVE_USBDEBUG
	select TINY_BOOTBLOCK
	select USE_WATCHDOG_ON_BOOT
	select PCIEXP_ASPM
	select PCIEXP_COMMON_CLOCK

if SOUTHBRIDGE_INTEL_BD82X6X

config EHCI_BAR
	hex
	default 0xfef00000

config EHCI_DEBUG_OFFSET
	hex
	default 0xa0

config BOOTBLOCK_SOUTHBRIDGE_INIT
	string
	default "southbridge/intel/bd82x6x/bootblock.c"

endif
```
